#include "5110.h"
#include <stdlib.h>
#include <string.h>
const uint8_t LCD_Config[6] = {0x21,0xc8,0x06,0x13,0x20,0x0c};
// 使用扩展命令设置LCD模式
// 设置偏置电压
// 温度校正
// 1:48
// 使用基本命令
// 设定显示模式，正常显示
const uint8_t font6x8[][6] =
{
	{ 0x00, 0x00, 0x00, 0x00, 0x00, 0x00 },   // sp
	{ 0x00, 0x00, 0x00, 0x2f, 0x00, 0x00 },   // !
	{ 0x00, 0x00, 0x07, 0x00, 0x07, 0x00 },   // "
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	{ 0x14, 0x14, 0x14, 0x14, 0x14, 0x14 }    // horiz lines
};
void delay_1us()
{
	int i;
	for(i=0;i<48;i++);
}
void LCD_write_byte(uint8_t dat, uint8_t command)
{
	LCD_CE_LOW(); 
	if ( !command )
		LCD_DC_LOW();
	else
		LCD_DC_High();
  while (SPI_I2S_GetFlagStatus(SPI1, SPI_I2S_FLAG_TXE) == RESET);
	SPI_SendData8(SPI1,dat);
  while (SPI_I2S_GetFlagStatus(SPI1, SPI_I2S_FLAG_BSY) == SET);
	LCD_CE_High();
}

void LCD_clear(void)
{
	uint16_t i;

	LCD_write_byte(0x0c, 0);			
	LCD_write_byte(0x80, 0);			
	LCD_CE_LOW(); 
	LCD_DC_High();
	while (SPI_I2S_GetFlagStatus(SPI1, SPI_I2S_FLAG_TXE) == RESET);
	for (i=0; i<504; i++)
	{
		SPI_SendData8(SPI1,0x00);
		while (SPI_I2S_GetFlagStatus(SPI1, SPI_I2S_FLAG_BSY) == SET);
	}
	LCD_CE_High();
}
void LCD_init(void)
{
	uint8_t i = 0;
	LCD_RST_LOW();
	delay_1us();
	LCD_RST_High();
	LCD_CE_LOW();
	delay_1us();
	LCD_CE_High();
	delay_1us();
	LCD_CE_LOW(); 
	LCD_DC_LOW();
	while (SPI_I2S_GetFlagStatus(SPI1, SPI_I2S_FLAG_TXE) == RESET);
	for (i = 0; i < 6; i++)
	{
		SPI_SendData8(SPI1,LCD_Config[i]);
		while (SPI_I2S_GetFlagStatus(SPI1, SPI_I2S_FLAG_BSY) == SET);
	}
	LCD_CE_High();
}
void LCD_Set_XY(uint8_t X, uint8_t Y)
{
	LCD_write_byte(0x40 | Y, 0);						// column
	LCD_write_byte(0x80 | X, 0);          	// row
}
void LCD_write_char(uint8_t c)
{
	uint8_t line;
	c -= 32;
	LCD_CE_LOW();
	LCD_DC_High();
	for (line=0; line<6; line++)
	{
		while (SPI_I2S_GetFlagStatus(SPI1, SPI_I2S_FLAG_TXE) == RESET);
		SPI_SendData8(SPI1,font6x8[c][line]);
		while (SPI_I2S_GetFlagStatus(SPI1, SPI_I2S_FLAG_BSY) == SET);
	}
	LCD_CE_High();
}
void LCD_E_Str(uint8_t X,uint8_t Y,char *s)
{
	LCD_Set_XY(X,Y);
	LCD_CE_LOW();
	LCD_DC_High();
	while(*s) 
	{
		uint8_t line;
		for (line=0; line<6; line++)
		{
			while (SPI_I2S_GetFlagStatus(SPI1, SPI_I2S_FLAG_TXE) == RESET);
			SPI_SendData8(SPI1,font6x8[*s - 32][line]);
			while (SPI_I2S_GetFlagStatus(SPI1, SPI_I2S_FLAG_BSY) == SET);
		}
		s++;
	}
	LCD_CE_High();
}
